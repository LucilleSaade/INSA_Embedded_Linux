## examples/meta-insa/conf/layer.conf
```bitbake
# We have a conf directory, add to BBPATH
BBPATH .= ":${LAYERDIR}"

# We have a recipes directory containing .bb and .bbappend files, add to BBFILES
BBFILES := "${BBFILES} ${LAYERDIR}/recipes-*/*/*.bb \
            ${LAYERDIR}/recipes-*/*/*.bbappend"

BBFILE_COLLECTIONS += "meta-insa"
BBFILE_PATTERN_meta-insa := "^${LAYERDIR}/"
BBFILE_PRIORITY_meta-insa = "10"
```
